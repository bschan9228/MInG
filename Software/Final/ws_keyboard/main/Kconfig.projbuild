## Software/Final/ws_keyboard/main/Kconfig.projbuild
```kconfig
# menu "HTTP Configuration"

#     config EXAMPLE_BASIC_AUTH
#         bool "Basic Authentication"
#         default n
#         help
#             Basic Authentication is a method for an HTTP user agent (e.g. a web browser)
#             to provide a user name and password when making a request. It is the simplest
#             technique for enforcing access controls to web resources. because it doesn't
#             require cookies, session identifiers, or login pages; rather, it uses standard
#             fields in the HTTP header.
#             Note that, Basic Authentication is not encrypted channel and also easy to retrieve
#             credentials as they are sent in plain text format.

#     config EXAMPLE_BASIC_AUTH_USERNAME
#         string "Basic Authenticate User Name"
#         depends on EXAMPLE_BASIC_AUTH
#         default "ESP32"
#         help
#             The client's user name which used for basic authenticate.

#     config EXAMPLE_BASIC_AUTH_PASSWORD
#         string "Basic Authenticate Password"
#         depends on EXAMPLE_BASIC_AUTH
#         default "ESP32Webserver"
#         help
#             The client's password which used for basic authenticate.

# endmenu


menu "Access Point Configuration"

    config ESP_WIFI_SSID
        string "WiFi SSID"
        default "myssid"
        help
            SSID (network name) for the example to connect to.

    config ESP_WIFI_PASSWORD
        string "WiFi Password"
        default "mypassword"
        help
            WiFi password (WPA or WPA2) for the example to use.
    config ESP_WIFI_CHANNEL
        int "WiFi Channel"
        range 1 13
        default 1
        help
            WiFi channel (network channel) for the example to use.

    config ESP_MAX_STA_CONN
        int "Maximal STA connections"
        default 4
        help
            Max number of the STA connects to AP.
endmenu
```
